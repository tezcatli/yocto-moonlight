## yocto-build/conf/bblayers.conf
```bitbake
# LAYER_CONF_VERSION is increased each time build/conf/bblayers.conf
# changes incompatibly
POKY_BBLAYERS_CONF_VERSION = "2"

LCONF_VERSION = "7"

BBPATH = "${TOPDIR}"
BBFILES ?= ""


YOCTOROOT = "${@os.path.abspath(os.path.join("${TOPDIR}", os.pardir))}"

BBLAYERS ?= " \
  ${YOCTOROOT}/poky/meta \
  ${YOCTOROOT}/poky/meta-freescale \
  ${YOCTOROOT}/poky/meta-poky \
  ${YOCTOROOT}/poky/meta-yocto-bsp \
  ${YOCTOROOT}/poky/meta-openembedded/meta-oe \
  ${YOCTOROOT}/poky/meta-openembedded/meta-networking \
  ${YOCTOROOT}/poky/meta-openembedded/meta-python \
  ${YOCTOROOT}/poky/meta-moonlight \
  "

BBLAYERS_NON_REMOVABLE ?= " \
  ${YOCTOROOT}/poky/meta \
  ${YOCTOROOT}/poky/meta-freescale \
  ${YOCTOROOT}/poky/meta-poky \
  ${YOCTOROOT}/poky/meta-openembedded/meta-oe \
  ${YOCTOROOT}/poky/meta-moonlight \
  "
```
